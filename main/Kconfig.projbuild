## main/Kconfig.projbuild
```kconfig
menu "Battlestation bring-up"

    config APP_WIFI_SSID
        string "Wi-Fi SSID (2.4 GHz only)"
        default ""
        help
            SSID of the 2.4 GHz access point. Leave empty to skip Wi-Fi and
            exercise only display, touch and audio. The ESP32-C6 does not
            support 5 GHz.

    config APP_WIFI_PASSWORD
        string "Wi-Fi password"
        default ""
        help
            WPA2/WPA3 password for the access point above.

    config APP_BACKLIGHT_PERCENT
        int "Backlight brightness (%)"
        range 10 100
        default 60
        help
            Initial backlight duty. 60% is a good stability-test default because
            it reduces 5 V/backlight current while keeping the panel readable.
            Raise to 100% only after the power path is known good.

    config APP_MIC_GAIN_DB
        int "ES7210 microphone PGA gain (dB)"
        range 0 37
        default 24
        help
            Applied equally to the two microphone channels. The ES7210 has
            discrete gain steps; the driver rounds to the nearest supported
            value. This affects dBFS readings, so keep it fixed while comparing
            measurements.

    choice APP_TEAR_MODE
        prompt "Display tear-avoid mode"
        default APP_TEAR_DOUBLE_DIRECT
        help
            DOUBLE_DIRECT + 180 + adapter 0.7.5 passed a 386 s soak with touch,
            audio and LVGL active. TRIPLE_PARTIAL deadlocks at ~26 s on this
            unit (adapter 0.6.4 and 0.7.5). TRIPLE_FULL is a slower fallback
            (75 s soak passed).

        config APP_TEAR_TRIPLE_PARTIAL
            bool "Triple partial (fastest; rotated path is broken on this unit)"

        config APP_TEAR_TRIPLE_FULL
            bool "Triple full (fallback, full-frame rotation)"

        config APP_TEAR_DOUBLE_DIRECT
            bool "Double direct (factory-style, validated default)"
    endchoice

    choice APP_DISPLAY_ROTATION
        prompt "Display rotation"
        default APP_ROTATION_180
        help
            180 matches the factory UI and the BSP's own bsp_display_start()
            default for this board. The 08 example uses 0 only as a diagnostic;
            it is not the product orientation. Choose 0 only if you physically
            mount the board the other way up. Touch flags are adjusted in
            main.c: 180 uses no mirrors, 0 uses mirror x/y.

        config APP_ROTATION_0
            bool "0 degrees (diagnostic / alternate mounting)"

        config APP_ROTATION_180
            bool "180 degrees (factory orientation)"
    endchoice

    config APP_SWITCH_SELFTEST
        bool "Run the M5 100-switch launcher self-test at boot"
        default n
        help
            Cycles launcher -> dashboard -> organism -> settings 25 times
            (100 switches), logging the LVGL child count and heap after each
            cycle. Use a dedicated test image; leave disabled for normal use.

    config APP_AUDIO_TEST_TONE
        bool "Play a 1 kHz test tone 2 s after boot"
        default n
        help
            Opens the tone playback lane, unmutes the speaker, plays 2 s of
            1 kHz at -20 dBFS, then 200 ms of silence and mutes/closes the
            lane. Diagnostic test image only; normal M6 operation starts muted.

endmenu

menu "Battlestation dashboard"

    config APP_TIMEZONE
        string "POSIX timezone (for example UTC0 or CET-1CEST)"
        default "UTC0"
        help
            Applied with setenv("TZ") + tzset() before SNTP starts. The
            dashboard shows the local time only after NTP sets a valid clock.

    config APP_HA_URL
        string "Home Assistant base URL (empty disables HA)"
        default ""
        help
            For example http://192.168.1.10:8123. Both the URL and the
            long-lived access token must be set for the HA client to run. The
            token is never written to logs. M7b supports plain http:// LAN
            URLs only; https:// is rejected because TLS is not enabled yet.
            Use an IP address or a name your DHCP DNS server resolves; mDNS
            .local names are not resolved in M7b.

    config APP_HA_TOKEN
        string "Home Assistant long-lived access token"
        default ""
        help
            Keep this out of git. The empty default makes the dashboard render
            an honest offline state until M10 adds runtime provisioning.

    config APP_LIGHT_ENTITY_0
        string "Light 0 entity ID"
        default ""
        help
            Home Assistant entity ID for the first light card.

    config APP_LIGHT_ENTITY_1
        string "Light 1 entity ID"
        default ""
        help
            Home Assistant entity ID for the second light card.

    config APP_LIGHT_ENTITY_2
        string "Light 2 entity ID"
        default ""
        help
            Home Assistant entity ID for the third light card.

    config APP_LIGHT_ENTITY_3
        string "Light 3 entity ID"
        default ""
        help
            Home Assistant entity ID for the fourth light card.

    config APP_WEATHER_ENTITY
        string "Weather entity ID"
        default ""
        help
            Home Assistant weather entity shown by the weather card. Leave
            empty to show the not-configured placeholder.

    config APP_HA_TEST
        bool "Run the HA light command self-test at boot"
        default n
        help
            After 8 s, queues light 0 on at 40% and then off. Use with a mock or
            real HA instance; normal images must leave this disabled.

endmenu
```

## probes/dsi/sdkconfig.defaults
```kconfig
CONFIG_IDF_TARGET="esp32p4"
# CONFIG_ESP32P4_SELECTS_REV_LESS_V3 is not set
CONFIG_ESP32P4_REV_MIN_300=y
CONFIG_ESPTOOLPY_FLASHMODE_QIO=y
CONFIG_ESPTOOLPY_FLASHSIZE_32MB=y
CONFIG_BOOTLOADER_LOG_LEVEL_WARN=y
CONFIG_BOOTLOADER_LOG_LEVEL=2
CONFIG_PARTITION_TABLE_CUSTOM=y
CONFIG_PARTITION_TABLE_CUSTOM_FILENAME="partitions.csv"
CONFIG_PARTITION_TABLE_OFFSET=0x9000
CONFIG_COMPILER_OPTIMIZATION_PERF=y
CONFIG_ESP_MAIN_TASK_STACK_SIZE=8192
CONFIG_FREERTOS_HZ=1000
CONFIG_SPIRAM=y
CONFIG_SPIRAM_SPEED_200M=y
CONFIG_SPIRAM_XIP_FROM_PSRAM=y
CONFIG_SPIRAM_USE_CAPS_ALLOC=y
CONFIG_CACHE_L2_CACHE_256KB=y
CONFIG_CACHE_L2_CACHE_LINE_128B=y
CONFIG_BSP_LCD_DPI_BUFFER_NUMS=3
CONFIG_ESP_CONSOLE_UART_DEFAULT=y
```
